## config/boards/shields/dance/Kconfig.defconfig
```kconfig
if SHIELD_DANCE_DONGLE

config ZMK_KEYBOARD_NAME
    default "Dance!"

config ZMK_SPLIT_ROLE_CENTRAL
    default y

config ZMK_SPLIT
    default y

config ZMK_SPLIT_BLE_CENTRAL_PERIPHERALS
    default 2

config BT_MAX_CONN
    default 2

config BT_MAX_PAIRED
    default 2

endif

if SHIELD_DANCE_DONGLE || SHIELD_DANCE_LEFT || SHIELD_DANCE_RIGHT

config ZMK_SPLIT
    default y

endif
```

## config/boards/shields/dance/Kconfig.shield
```kconfig
# Copyright (c) 2020 Pete Johanson
# SPDX-License-Identifier: MIT

config SHIELD_DANCE_LEFT
    def_bool $(shields_list_contains,dance_left)

config SHIELD_DANCE_RIGHT
    def_bool $(shields_list_contains,dance_right)
```

## config/west.yml
```yaml
manifest:
  remotes:
    - name: chase-hunter
      url-base: https://github.com/chase-hunter
    - name: petejohanson
      url-base: https://github.com/petejohanson
    #- name: m165437 #nice-view-gem
    #  url-base: https://github.com/M165437 #nice-view-gem

    # Conf for dongle
    - name: carrefinho                            # <---
      url-base: https://github.com/carrefinho     # <---
    - name: caksoylar                             # <---
      url-base: https://github.com/caksoylar      # <---
  projects:
    - name: zmk
      remote: petejohanson
      revision: feat/pointers-with-input-processors
      import: app/west.yml
    - name: nice-shield-p #pig
      remote: chase-hunter #pig
      revision: main #pig

    # Conf for dongle
    - name: prospector-zmk-module
      remote: carrefinho
      revision: main
    - name: zmk-rgbled-widget                     # <---
      remote: caksoylar                           # <---
      revision: main                              # <---
  self:
    path: config
```
