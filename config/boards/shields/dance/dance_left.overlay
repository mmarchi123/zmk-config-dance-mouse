/*
 * Copyright (c) 2020 Pete Johanson
 *
 * SPDX-License-Identifier: MIT
 */
#include "dance.dtsi"

/ {
    // Split configuration for left peripheral
    split: split {
        compatible = "zmk,split";
        central-ble-address-offset = <0>;      // Central (dongle) = address 0
        peripheral-ble-address-offset = <1>;   // Left = address 1
    };
};

&kscan0 {
    col-gpios
        = <&pro_micro 21 GPIO_ACTIVE_HIGH>
        , <&pro_micro 20 GPIO_ACTIVE_HIGH>
        , <&pro_micro 19 GPIO_ACTIVE_HIGH>
        , <&pro_micro 18 GPIO_ACTIVE_HIGH>
        , <&pro_micro 15 GPIO_ACTIVE_HIGH>
        ;
};
